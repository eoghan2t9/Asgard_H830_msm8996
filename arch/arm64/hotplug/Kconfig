## arch/arm64/hotplug/Kconfig
```kconfig
menuconfig ARM64_HOTPLUG
	bool "ARM64 Hotplug Drivers"
	depends on ARM64
	help
	  Say Y here to choose from a selection of cryptographic algorithms
	  implemented using ARM64 specific CPU Hotplugging.

if ARM64_HOTPLUG

config CLUSTER_PLUG
        bool "Enable cluster-plug cpu hotplug driver"
        default n
        help
          CPU hotplug driver designed for ARM big.LITTLE systems where
          both the big and little CPUs are of the same type. On these
          systems, it preferable to normall use the big cluster, and
          only activate the little cluster for highly parallel loads.
          This hotplug implementation always keeps the big cluster
          online, and only activates the little cluster for heavy
          parallel loads

config AUTOSMP
	bool "Multi-core automatic hotplug support"
	depends on SMP && HOTPLUG_CPU
	help
	  Automatically hotplugs the multiple cpu cores on and off
	  based on cpu load and suspend state
endif
```
